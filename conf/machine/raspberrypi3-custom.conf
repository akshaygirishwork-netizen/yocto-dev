## meta-custom/conf/distro/custom-distro.conf
```bitbake
require conf/distro/poky.conf

DISTRO_FEATURES:append = " systemd"
VIRTUAL-RUNTIME_init_manager = "systemd"
VIRTUAL-RUNTIME_initscripts = ""
```

## meta-custom/wic/core-image-minimal.wks
```
# core-image-minimal.wks
part /boot --source bootimg-partition --sourceparams="loader=u-boot.bin" --ondisk mmcblk0 --fstype=vfat --label boot --active
part / --source rootfs --ondisk mmcblk0 --fstype=ext4 --label rootfs1
part / --source rootfs --ondisk mmcblk0 --fstype=ext4 --label rootfs2
```

## meta-customqemuqrm/conf/layer.conf
```bitbake
# We have a conf and classes directory, add to BBPATH
BBPATH .= ":${LAYERDIR}"

# We have recipes-* directories, add to BBFILES
BBFILES += "${LAYERDIR}/recipes-*/*/*.bb \
            ${LAYERDIR}/recipes-*/*/*.bbappend \
            ${LAYERDIR}/recipes-*/*.bbappend"

BBFILE_COLLECTIONS += "meta-customqemuqrm"
BBFILE_PATTERN_meta-customqemuqrm = "^${LAYERDIR}/"
BBFILE_PRIORITY_meta-customqemuqrm = "6"

LAYERDEPENDS_meta-customqemuqrm = "core"
LAYERSERIES_COMPAT_meta-customqemuqrm = "kirkstone"
```

## wic/core-image-minimal.wks
```
# core-image-minimal.wks
part / --source rootfs --ondisk mmcblk0 --fstype=ext4 --label rootfs
```
